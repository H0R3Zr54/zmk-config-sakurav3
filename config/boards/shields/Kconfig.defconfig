## config/boards/shields/Kconfig.defconfig
```kconfig
if SHIELD_SAKURA_LEFT

config ZMK_KEYBOARD_NAME
    default "Sakura"

config ZMK_SPLIT_ROLE_CENTRAL
    default y

endif

if SHIELD_SAKURA_LEFT || SHIELD_SAKURA_RIGHT

config ZMK_SPLIT
    default y

endif
```

## config/boards/shields/Kconfig.shield
```kconfig
config SHIELD_SAKURA_LEFT
    def_bool $(shields_list_contains,sakura_left)

config SHIELD_SAKURA_RIGHT
    def_bool $(shields_list_contains,sakura_right)
```
